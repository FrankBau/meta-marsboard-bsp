## conf/layer.conf
```bitbake
# We have a conf and classes directory, add to BBPATH
BBPATH .= ":${LAYERDIR}"

# We have recipes-* directories, add to BBFILES
BBFILES += "${LAYERDIR}/recipes-*/*/*.bb \
            ${LAYERDIR}/recipes-*/*/*.bbappend"

BBFILE_COLLECTIONS += "meta-marsboard-bsp"
BBFILE_PATTERN_meta-marsboard-bsp = "^${LAYERDIR}/"
BBFILE_PRIORITY_meta-marsboard-bsp = "6"
LAYERVERSION_meta-marsboard-bsp = "3"
```

## conf/machine/marsboard.conf
```bitbake
#@TYPE: Machine
#@NAME: embest-tech MarSboard 
#@SOC: i.MX6D
#@DESCRIPTION: Machine configuration for embest-tech MarSboard
#@MAINTAINER: Frank Bauernoeppel marsboard@bauernoeppel.de

include conf/machine/include/imx-base.inc
include conf/machine/include/tune-cortexa9.inc

MACHINEOVERRIDES =. "mx6:mx6q:"

UBOOT_MACHINE = "marsboard_config"

# see http://freescale.github.io/doc/release-notes/2.2/
# but the gist server seems to be not reliable...
# PREFERRED_PROVIDER_virtual/kernel ?= "linux-imx"
PREFERRED_PROVIDER_virtual/kernel ?= "linux-marsboard"
KERNEL_DEVICETREE = "imx6q-marsboard.dtb"

SERIAL_CONSOLE = "115200 ttymxc1"

MACHINE_ESSENTIAL_EXTRA_RDEPENDS += " \
    kernel-image \
    kernel-devicetree \
    u-boot-fslc \
"

WKS_FILE ?= "sdimage-bootpart.wks"
IMAGE_BOOT_FILES = " \
  u-boot.imx \
  zImage-imx6q-marsboard.dtb;imx6q-marsboard.dtb \
  zImage \
"

IMAGE_FSTYPES = "wic.gz"
```
